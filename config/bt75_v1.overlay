/ {
    aliases {
        i2c1 = &twim1;
    };

    /* Aktifkan TWIM1 (I2C1) pada pin P0.26=SDA, P0.27=SCL */
    &twim1 {
        status = "okay";
        sda-pin = <17>;
        scl-pin = <20>;
        bus-frequency = <400000>;
        pinctrl-0 = <&twim1_default>;
        pinctrl-names = "default";
    };

    /* Definisi OLED SSD1306 di alamat 0x3C */
    oled: ssd1306@3c {
        compatible = "solomon,ssd1306";
        reg = <0x3c>;
        width = <128>;
        height = <64>;
        label = "SSD1306";
        status = "okay";
    };
};
