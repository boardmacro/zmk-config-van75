#include <behaviors.dtsi>
#include <dt-bindings/zmk/keys.h>

/ {
    keymap {
        compatible = "zmk,keymap";

        default_layer {
            // Minimal 1 binding supaya Devicetree valid
            bindings = <
                &none
            >;
        };
    };
};
